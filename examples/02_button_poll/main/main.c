/*
 * Пример 02. Кнопка опросом, с антидребезгом.
 *
 * Опрос (polling) — самый прямой способ прочитать кнопку: программа
 * сама регулярно спрашивает «какой сейчас уровень на выводе?».
 * Пока кнопка не нажата, задача просто спит по 10 мс и проверяет снова.
 *
 * У механической кнопки контакты дребезжат: за одно нажатие уровень
 * несколько раз успевает смениться с 0 на 1 и обратно. Если считать
 * каждое такое изменение отдельным нажатием, одно касание превратится
 * в пачку срабатываний. Поэтому после первого обнаружения программа
 * ждёт 30 мс и проверяет уровень ещё раз. Это и есть антидребезг.
 *
 * Кнопка в исходном проекте с дисплеем подключена к GPIO9 и замыкает
 * вывод на землю. Здесь используется та же схема.
 */

#include <stdbool.h> /* bool — «кнопка зажата» и «светодиод горит» удобнее хранить так. */

/*
 * Библиотеки:
 * freertos/FreeRTOS.h и freertos/task.h — сон задачи на время антидребезга.
 *   Опрос кнопки не должен жечь процессор в пустом цикле.
 * driver/gpio.h — два вывода: GPIO9 читаем как вход, GPIO8 держим как выход.
 * esp_log.h — печатать номер нажатия в монитор.
 */
#include "freertos/FreeRTOS.h" /* Типы планировщика. task.h без этого файла не соберётся. */
#include "freertos/task.h"     /* vTaskDelay: пауза опроса, процессор в это время отдан другим задачам. */
#include "driver/gpio.h"       /* Настроить GPIO9 как вход кнопки и GPIO8 как выход светодиода. */
#include "esp_log.h"           /* ESP_LOGI печатает номер нажатия в монитор. */

/* Кнопка BOOT на большинстве плат ESP32-C3 тоже сидит на GPIO9. */
#define BUTTON_GPIO GPIO_NUM_9 /* Вывод кнопки: она замыкает его на землю. */

/* Светодиод переключается по каждому подтверждённому нажатию. */
#define LED_GPIO GPIO_NUM_8 /* Вывод светодиода, который переключаем по нажатию. */
#define LED_ON_LEVEL 0      /* Уровень «горит». Здесь диод зажигается нулём, не единицей. */

/* Сколько ждать, пока контакты кнопки перестанут дребезжать. */
#define DEBOUNCE_MS 30 /* Пауза антидребезга в миллисекундах перед повторным чтением. */

/* Имя модуля в скобках у каждой строки монитора. */
static const char *TAG = "button_poll"; /* Подпись в скобках перед каждой строкой этого примера. */

static void led_set(bool on) /* true зажигает светодиод, false гасит. Полярность платы спрятана внутри. */
{
    /* LED_ON_LEVEL учитывает платы, где светодиод горит нулём, а не единицей. */
    int level = on ? LED_ON_LEVEL : (1 - LED_ON_LEVEL); /* 0 или 1 на вывод: «выкл» — противоположный уровень включения. */
    gpio_set_level(LED_GPIO, level); /* Сразу выставить уровень: диод загорается или гаснет. */
}

/* Кнопка замыкает вывод на землю, поэтому «нажато» — это уровень 0. */
static bool button_is_down(void) /* true, пока кнопка прижата. Так опрос не повторяет сравнение с нулём. */
{
    /* gpio_get_level читает вывод прямо сейчас: 0 или 1, без ожидания. */
    return gpio_get_level(BUTTON_GPIO) == 0; /* 0 и есть нажатие: контакт тянет вывод к земле. */
}

void app_main(void) /* Точка входа. ESP-IDF вызывает её уже из задачи FreeRTOS. */
{
    ESP_LOGI(TAG, "кнопка GPIO%d, светодиод GPIO%d", BUTTON_GPIO, LED_GPIO); /* В мониторе видно, какие выводы заняты. */

    gpio_config_t button = { /* Описание входа кнопки. Пока это переменная, вывод ещё не переключён. */
        .pin_bit_mask = 1ULL << BUTTON_GPIO, /* Бит 9: настраиваем только GPIO9. 1ULL делает маску 64-битной. */
        .mode = GPIO_MODE_INPUT, /* Вход: уровень задаёт кнопка, программа его только читает. */
        /*
         * Внутренняя подтяжка к питанию. Пока кнопку не трогают,
         * на входе стабильная 1. Нажатие притягивает вход к земле (0).
         * Без подтяжки ненажатый вход «висит в воздухе» и читается случайно.
         */
        .pull_up_en = GPIO_PULLUP_ENABLE, /* Подтяжка к питанию: без нажатия на входе держится 1. */
        .pull_down_en = GPIO_PULLDOWN_DISABLE, /* К земле не тянем: иначе подтяжки спорили бы друг с другом. */
        /* Опрос сам читает уровень, аппаратное прерывание здесь не включаем. */
        .intr_type = GPIO_INTR_DISABLE, /* Прерывание выключено: уровень спрашиваем сами в цикле ниже. */
    };
    /* Если настройка вывода не удалась, дальше читать кнопку бессмысленно. */
    ESP_ERROR_CHECK(gpio_config(&button)); /* Записать настройку в контроллер. Ошибка остановит программу. */

    gpio_config_t led = { /* Описание выхода светодиода. */
        .pin_bit_mask = 1ULL << LED_GPIO, /* В маске только GPIO8, кнопку эта структура не трогает. */
        .mode = GPIO_MODE_OUTPUT, /* Выход: 0 и 1 на лампе ставит программа. */
        .pull_up_en = GPIO_PULLUP_DISABLE, /* Выходу подтяжка вверх не нужна. */
        .pull_down_en = GPIO_PULLDOWN_DISABLE, /* Подтяжка вниз тоже не нужна: уровень держит сам выход. */
        .intr_type = GPIO_INTR_DISABLE, /* У лампы нет входных событий, прерывание не включаем. */
    };
    ESP_ERROR_CHECK(gpio_config(&led)); /* Применить настройку светодиода до первого включения. */
    led_set(false); /* Погасить лампу на старте: первое подтверждённое нажатие её зажжёт. */

    int presses = 0; /* Сколько нажатий уже засчитано. В логе будут номера 1, 2, 3… */
    bool led_on = false; /* Лампа пока выключена. Нажатие перевернёт это значение. */

    while (true) { /* Опрос не заканчивается: кнопку проверяем всё время работы. */
        if (button_is_down()) { /* На входе 0. Это может быть нажатие, а может дребезг контактов. */
            /* Первое чтение могло попасть в дребезг. Ждём и читаем снова. */
            vTaskDelay(pdMS_TO_TICKS(DEBOUNCE_MS)); /* Спать 30 мс. За паузу контакты успокаиваются, ядро свободно. */
            if (button_is_down()) { /* После паузы всё ещё 0: нажатие настоящее, не одиночный импульс. */
                presses++;          /* Счётчик только для журнала, на железо не влияет. */
                led_on = !led_on;   /* Каждое подтверждённое нажатие переворачивает свет. */
                led_set(led_on); /* Выставить на вывод уровень, соответствующий новому состоянию. */
                ESP_LOGI(TAG, "нажатие %d, светодиод %s", /* Строка в монитор: номер нажатия и состояние лампы. */
                         presses, led_on ? "включён" : "выключен"); /* Подставить счётчик и слово «включён» или «выключен». */

                /* Ждём отпускания, иначе одно удержание даст много нажатий. */
                while (button_is_down()) { /* Пока палец держит кнопку, новое нажатие не считаем. */
                    vTaskDelay(pdMS_TO_TICKS(10)); /* Спать по 10 мс, чтобы ожидание отпускания не заняло процессор. */
                }
                /* И короткий дребезг на отпускании тоже пропускаем. */
                vTaskDelay(pdMS_TO_TICKS(DEBOUNCE_MS)); /* Ещё 30 мс: дребезг размыкания не станет следующим нажатием. */
            }
        }
        vTaskDelay(pdMS_TO_TICKS(10)); /* Пауза между опросами. Кнопку не нужно читать тысячи раз в секунду. */
    }
}
