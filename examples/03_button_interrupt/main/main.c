/*
 * Пример 03. Кнопка через прерывание GPIO и очередь FreeRTOS.
 *
 * Прерывание — это аппаратный сигнал «на выводе что-то произошло».
 * Процессор бросает текущую работу, выполняет короткую функцию-обработчик
 * и возвращается назад. Основная программа в это время может спать
 * в ожидании события, а не опрашивать кнопку в цикле.
 *
 * В обработчике прерывания нельзя делать почти ничего долгого:
 * нельзя вызывать printf, ESP_LOG, vTaskDelay и большинство драйверов.
 * Разрешены только операции, в имени которых есть FromISR.
 * Поэтому обработчик лишь кладёт номер вывода в очередь. Разбором
 * события занимается обычная задача — там уже можно и ждать, и печатать.
 *
 * Это тот же приём, что в исходном проекте с дисплеем (isr_handler +
 * button_task), только здесь он разобран по шагам и дополнен антидребезгом.
 */

#include <inttypes.h> /* Макрос PRIu32: печатать uint32_t переносимым способом. */
#include <stdbool.h>  /* bool хранит, горит ли светодиод. */

/*
 * Библиотеки:
 * freertos/FreeRTOS.h — базовые типы. queue.h и task.h подключают после него.
 * freertos/queue.h — очередь, почтовый ящик из прерывания в обычную задачу.
 * freertos/task.h — xTaskCreate создаёт задачу, которая разбирает нажатия.
 * driver/gpio.h — настроить вход, повесить обработчик на спад уровня,
 *   прочитать gpio_get_level уже в задаче.
 * esp_log.h — печать разрешена только в задаче, не в обработчике прерывания.
 */
#include "freertos/FreeRTOS.h" /* Базовые типы. Этот файл подключают раньше queue.h и task.h. */
#include "freertos/queue.h"    /* Очередь: обработчик кладёт номер вывода, задача его забирает. */
#include "freertos/task.h"     /* xTaskCreate и vTaskDelay для задачи, которая разбирает нажатия. */
#include "driver/gpio.h"       /* Вход кнопки, обработчик на спад и чтение уровня уже в задаче. */
#include "esp_log.h"           /* Печать в монитор. Из обработчика прерывания её вызывать нельзя. */

#define BUTTON_GPIO GPIO_NUM_9 /* Кнопка на GPIO9, замыкает вывод на землю. */
#define LED_GPIO GPIO_NUM_8    /* Светодиод на GPIO8, его переключает подтверждённое нажатие. */
#define LED_ON_LEVEL 0         /* Уровень «горит»: на этой плате лампа включается нулём. */
#define DEBOUNCE_MS 40         /* После события ждём 40 мс и только потом верим уровню. */

static const char *TAG = "button_isr"; /* Подпись строк примера в мониторе. */

/*
 * Очередь — почтовый ящик между прерыванием и задачей.
 * Элемент очереди: номер GPIO, на котором случилось событие.
 * Одной очереди хватает и на несколько кнопок.
 */
static QueueHandle_t s_button_queue; /* Ящик для номеров GPIO. Саму очередь создадим в app_main. */

static void led_set(bool on) /* true зажигает лампу, false гасит, полярность платы учтена внутри. */
{
    int level = on ? LED_ON_LEVEL : (1 - LED_ON_LEVEL); /* Выбираем 0 или 1: «выкл» — уровень напротив включения. */
    gpio_set_level(LED_GPIO, level); /* Записать уровень на вывод светодиода. */
}

/*
 * IRAM_ATTR кладёт функцию во внутреннюю RAM. Обработчик GPIO должен
 * быть доступен даже в те моменты, когда flash-кэш выключен.
 * Из этой функции виден только аргумент, который мы сами передали
 * при регистрации, — номер вывода.
 */
static void IRAM_ATTR button_isr(void *arg) /* Короткий обработчик спада. Долга работа здесь запрещена. */
{
    uint32_t gpio = (uint32_t)arg; /* Номер вывода, который передали при регистрации обработчика. */
    /*
     * Третий аргумент — флаг «разблокировать более приоритетную задачу».
     * Нам он не нужен: NULL означает «не сообщай».
     * xQueueSendFromISR не ждёт свободного места. Если очередь полна,
     * событие просто теряется. Для кнопки это нормально: дребезг
     * и так создаёт лишние события.
     */
    xQueueSendFromISR(s_button_queue, &gpio, NULL); /* Кладём номер в очередь и не ждём. NULL: задачу срочно не будим. */
}

static void button_task(void *arg) /* Обычная задача: здесь уже можно ждать, читать кнопку и печатать. */
{
    /* xTaskCreate передала NULL. Подавляем предупреждение о неиспользуемом аргументе. */
    (void)arg; /* Параметр задаче не нужен, без этого компилятор предупредит о нём. */
    uint32_t gpio = 0; /* Сюда очередь положит номер вывода, с которого пришло событие. */
    int presses = 0; /* Сколько нажатий уже подтвердилось. Число нужно для текста в логе. */
    bool led_on = false; /* Лампа стартует выключенной, каждое нажатие переворачивает флаг. */

    while (true) { /* Задача живёт всё время: спит на очереди и просыпается на событии. */
        /*
         * portMAX_DELAY — ждать сколько угодно. Задача спит и не занимает
         * процессор, пока прерывание не положит номер вывода в очередь.
         */
        if (xQueueReceive(s_button_queue, &gpio, portMAX_DELAY) != pdTRUE) { /* Ждём номер вывода. Не дождались — элемент не копируем. */
            continue; /* События нет: остальной разбор пропускаем и снова встаём на очередь. */
        }

        /* Событие пришло. Даём контактам успокоиться и проверяем уровень. */
        vTaskDelay(pdMS_TO_TICKS(DEBOUNCE_MS)); /* Сон 40 мс: дребезг успевает закончиться до повторного чтения. */
        if (gpio_get_level(BUTTON_GPIO) == 0) { /* После паузы на входе всё ещё 0: кнопку правда держат. */
            presses++; /* Номер нажатия для следующей строки лога. */
            led_on = !led_on; /* Переворачиваем запомненное состояние лампы. */
            led_set(led_on); /* Выводим новое состояние на GPIO светодиода. */
            ESP_LOGI(TAG, "GPIO%" PRIu32 " нажатие %d, светодиод %s", /* Печатаем вывод, номер нажатия и состояние лампы. */
                     gpio, presses, led_on ? "включён" : "выключен"); /* Подставляем номер GPIO, счётчик и слово состояния. */

            while (gpio_get_level(BUTTON_GPIO) == 0) { /* Пока уровень 0, удержание не считаем новыми нажатиями. */
                vTaskDelay(pdMS_TO_TICKS(10)); /* Сон по 10 мс, чтобы ожидание отпускания не грузило ядро. */
            }
        }

        /* Выбрасываем события, которые дребезг успел положить в очередь. */
        while (xQueueReceive(s_button_queue, &gpio, 0) == pdTRUE) { /* Забираем хвост без ожидания: это лишние фронты дребезга. */
        }
    }
}

void app_main(void) /* Старт: выводы, очередь, сервис прерываний и задача кнопки. */
{
    ESP_LOGI(TAG, "прерывание по спаду на GPIO%d", BUTTON_GPIO); /* В мониторе видно, что ждём переход 1 в 0 на кнопке. */

    gpio_config_t button = { /* Параметры входа, включая момент прерывания. */
        .pin_bit_mask = 1ULL << BUTTON_GPIO, /* Бит номера кнопки: остальные выводы эта маска не трогает. */
        .mode = GPIO_MODE_INPUT, /* Вход: уровень задаёт кнопка, не программа. */
        .pull_up_en = GPIO_PULLUP_ENABLE, /* Подтяжка к питанию держит 1, пока кнопку не нажали. */
        .pull_down_en = GPIO_PULLDOWN_DISABLE, /* Нижнюю подтяжку не включаем, она мешала бы верхней. */
        /* NEGEDGE — прерывание в момент перехода 1 -> 0, то есть на нажатии. */
        .intr_type = GPIO_INTR_NEGEDGE, /* Тревога на спаде: именно в момент нажатия, не на отпускании. */
    };
    ESP_ERROR_CHECK(gpio_config(&button)); /* Применить вход. Если вывод не открылся, дальше идти нельзя. */

    gpio_config_t led = { /* Параметры выхода светодиода. */
        .pin_bit_mask = 1ULL << LED_GPIO, /* Маска только для вывода лампы. */
        .mode = GPIO_MODE_OUTPUT, /* Выход: уровнем лампы управляет программа. */
        .pull_up_en = GPIO_PULLUP_DISABLE, /* На выходе подтяжка вверх не нужна. */
        .pull_down_en = GPIO_PULLDOWN_DISABLE, /* Подтяжка вниз тоже выключена. */
        .intr_type = GPIO_INTR_DISABLE, /* Прерывание на лампе не используем. */
    };
    /* ESP_ERROR_CHECK остановит программу, если вывод не удалось настроить. */
    ESP_ERROR_CHECK(gpio_config(&led)); /* Записать настройку лампы. Ошибка остановит программу здесь. */
    led_set(false); /* Стартуем с выключенной лампой. */

    /* Глубина 8: дребезг может дать несколько событий подряд, это нормально. */
    s_button_queue = xQueueCreate(8, sizeof(uint32_t)); /* Очередь на 8 номеров вывода. Элемент копируется побайтно. */
    if (s_button_queue == NULL) { /* Памяти нет: прерыванию некуда положить номер вывода. */
        ESP_LOGE(TAG, "не удалось создать очередь"); /* Красная строка в мониторе, почтовый ящик не создан. */
        return; /* Выходим из app_main. Без очереди обработчик подключать нельзя. */
    }

    /*
     * Сервис прерываний GPIO ставится один раз на всё приложение.
     * Аргумент — флаги. 0 означает «без особых требований к памяти».
     * Ноль в ESP_INTR_FLAG_IRAM понадобился бы, только если обработчик
     * обязан работать при выключенном кэше flash.
     */
    ESP_ERROR_CHECK(gpio_install_isr_service(0)); /* Один раз включаем общий сервис прерываний GPIO. 0 — обычные флаги. */
    ESP_ERROR_CHECK(gpio_isr_handler_add(BUTTON_GPIO, button_isr, (void *)BUTTON_GPIO)); /* На спад GPIO9 звать button_isr и передать ей номер вывода. */

    /*
     * xTaskCreate в ESP-IDF принимает размер стека в байтах, не в словах.
     * Это отличие от «классического» FreeRTOS, где стек задают в словах.
     * 3072 байта с запасом хватает на ESP_LOGI.
     * Приоритет 5 выше приоритета задачи main (обычно 1): реакция на
     * кнопку важнее фонового цикла, если бы он здесь был.
     */
    BaseType_t ok = xTaskCreate(button_task, "button", 3072, NULL, 5, NULL); /* Задача разбора: имя «button», стек 3072 байта, приоритет 5. */
    if (ok != pdPASS) { /* Планировщик не создал задачу. Обычно так кончается память. */
        ESP_LOGE(TAG, "не удалось создать задачу кнопки"); /* Сообщаем: нажатия разбирать будет некому. */
    }
}
