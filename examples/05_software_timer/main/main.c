/*
 * Пример 05. Программные таймеры FreeRTOS.
 *
 * Программный таймер — это не отдельная периферия чипа и не отдельная
 * задача на каждый интервал. Все такие таймеры обслуживает одна системная
 * задача, её обычно зовут Tmr Svc. Когда интервал истекает, эта задача
 * вызывает вашу функцию.
 *
 * Отсюда два следствия:
 *   1. Колбэк таймера не должен долго работать и не должен брать мьютекс,
 *      который может держать кто-то ещё. Пока колбэк не вернулся,
 *      остальные программные таймеры не обслуживаются.
 *   2. Точность — порядка одного тика FreeRTOS (обычно 10 мс), не микросекунды.
 *      Для микросекунд есть esp_timer и аппаратный GPTimer, пример 06.
 *
 * Здесь два таймера:
 *   periodic — срабатывает каждую секунду и увеличивает счётчик;
 *   oneshot  — один раз, через 5 секунд после старта.
 */

/*
 * Библиотеки:
 * freertos/FreeRTOS.h — типы планировщика, подключается до task.h и timers.h.
 * freertos/task.h — vTaskDelay в задаче main, чтобы она не крутилась без паузы.
 * freertos/timers.h — программные таймеры: xTimerCreate и xTimerStart.
 *   Это не аппаратный таймер чипа, а служба внутри FreeRTOS.
 * esp_log.h — печать из колбэка таймера и из main.
 */
#include "freertos/FreeRTOS.h" /* Типы планировщика. timers.h опирается на них, поэтому файл первый. */
#include "freertos/task.h"     /* vTaskDelay: пауза в main, чтобы задача не крутилась без сна. */
#include "freertos/timers.h"   /* Программные таймеры FreeRTOS: создать и отдать команду службе. */
#include "esp_log.h"           /* Печать из колбэков и из main. */

static const char *TAG = "sw_timer"; /* Подпись строк этого примера в мониторе. */

/*
 * volatile: переменную пишут в одной задаче, а читают в другой.
 * Без volatile компилятор имеет право закэшировать старое значение
 * в регистре и не увидеть новые тики.
 */
static volatile int s_ticks; /* Счётчик секундных тиков. Пишет колбэк, читает main. */

static void periodic_callback(TimerHandle_t timer) /* Служба таймеров зовёт это раз в секунду. Долго тут работать нельзя. */
{
    (void)timer; /* Описатель таймера не нужен: период и так один. */
    s_ticks++; /* Плюс один тик. Задача main прочитает это число в своём цикле. */
    /*
     * ESP_LOGI из колбэка программного таймера допустим, если сообщение короткое.
     * Долгую работу (сеть, запись во flash, ожидание кнопки) отсюда запускать нельзя:
     * лучше дать семафор отдельной задаче.
     */
    ESP_LOGI(TAG, "периодический таймер, тик %d", s_ticks); /* Короткий лог. Пока он печатается, другие программные таймеры ждут. */
}

static void oneshot_callback(TimerHandle_t timer) /* Один вызов через 5 с. Сам этот таймер больше не повторится. */
{
    (void)timer; /* Описатель не используем: текст сообщения фиксированный. */
    ESP_LOGW(TAG, "одноразовый таймер сработал. Повторно сам он не запустится"); /* Предупреждение: pdFALSE-таймер после вызова молчит. */
}

void app_main(void) /* Создаёт оба таймера, запускает их и раз в 3 с печатает счётчик. */
{
    ESP_LOGI(TAG, "запуск двух программных таймеров"); /* Отметка в мониторе до создания таймеров. */

    /*
     * Аргументы xTimerCreate:
     *   имя          — видно в отладчике, на работу не влияет;
     *   период       — в тиках, не в миллисекундах;
     *   pdTRUE       — периодический, pdFALSE — один раз;
     *   id           — произвольное число, его можно прочитать в колбэке;
     *   функция      — кого вызвать по истечении периода.
     *
     * Таймер создаётся остановленным. Время пойдёт только после xTimerStart.
     */
    TimerHandle_t periodic = xTimerCreate( /* Периодический таймер. Пока остановлен, секунды ещё не идут. */
        "period", pdMS_TO_TICKS(1000), pdTRUE, (void *)1, periodic_callback); /* Имя, период 1 с, pdTRUE — повторять, id 1, колбэк. */
    TimerHandle_t oneshot = xTimerCreate( /* Одноразовый таймер, тоже ещё стоит. */
        "once", pdMS_TO_TICKS(5000), pdFALSE, (void *)2, oneshot_callback); /* 5 с, pdFALSE — один раз, id 2, свой колбэк. */

    if (periodic == NULL || oneshot == NULL) { /* xTimerCreate вернул пусто. Чаще всего не хватило кучи. */
        ESP_LOGE(TAG, "таймер не создан. Часто это значит, что не хватило кучи"); /* Пишем причину: без объекта колбэк не вызвать. */
        return; /* Выходим. Запускать нечего, задача main на этом удалится. */
    }

    /*
     * Второй аргумент xTimerStart — сколько тиков ждать, если очередь
     * команды таймерной задаче занята. 0 означает «не ждать»: для старта
     * из app_main очередь пуста, команда помещается сразу.
     */
    if (xTimerStart(periodic, 0) != pdPASS || xTimerStart(oneshot, 0) != pdPASS) { /* Команда старта обоим. 0: очередь службы пуста, ждать не нужно. */
        ESP_LOGE(TAG, "не удалось запустить таймер"); /* Служба не взяла команду, интервалы не пойдут. */
        return; /* Выходим, чтобы не печатать тики так, будто таймеры идут. */
    }

    while (true) { /* main остаётся жить и время от времени смотрит на s_ticks. */
        vTaskDelay(pdMS_TO_TICKS(3000)); /* Сон 3 с. За паузу секундный таймер успевает тикнуть около трёх раз. */
        ESP_LOGI(TAG, "main видит %d тиков периодического таймера", s_ticks); /* Сколько раз колбэк уже увеличил счётчик. */
    }
}
