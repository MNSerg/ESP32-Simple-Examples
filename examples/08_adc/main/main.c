/*
 * Пример 08. АЦП: чтение напряжения на GPIO4.
 *
 * АЦП (ADC) превращает напряжение на входе в целое число.
 * На ESP32-C3 разрядность по умолчанию — 12 бит: сырое значение лежит
 * в диапазоне 0…4095. Само по себе это число ещё не вольты. Перевод
 * в милливольты делает калибровка, записанная в чип на заводе
 * (схема curve fitting).
 *
 * У АЦП есть ослабление (attenuation). Оно выбирает, какой диапазон
 * напряжений растянуть на эти 4095 отсчётов. ADC_ATTEN_DB_12 на C3
 * покрывает примерно 0…3.3 В — как раз питание платы.
 * Без ослабления верхняя граница была бы около 1 В, и 3.3 В уже
 * нечем было бы отличить от перегрузки.
 *
 * В ESP-IDF 6 старый драйвер driver/adc.h удалён. Нужен oneshot-драйвер
 * из esp_adc/adc_oneshot.h: одно измерение по явному вызову.
 *
 * Важно: на ESP32-C3 блок ADC2 делит ресурсы с Wi-Fi. Пока Wi-Fi выключен,
 * ADC2 ещё можно читать, но в обычной программе с сетью используют ADC1.
 * Этот пример читает только ADC1.
 */

/*
 * Библиотеки:
 * freertos/FreeRTOS.h и task.h — пауза полсекунды между измерениями.
 * esp_adc/adc_oneshot.h — одно измерение по вызову, без непрерывного потока.
 *   Старый driver/adc.h в ESP-IDF 6 удалён, поэтому заголовок именно такой.
 * esp_adc/adc_cali.h — перевод сырого кода АЦП в милливольты.
 * esp_adc/adc_cali_scheme.h — заводская калибровка curve fitting, она есть на C3.
 * esp_log.h — печать сырого кода и напряжения.
 */
#include "freertos/FreeRTOS.h" /* Типы FreeRTOS. Пауза между измерениями без них не соберётся. */
#include "freertos/task.h" /* vTaskDelay: полсекунды сна, а не пустой цикл. */
#include "esp_adc/adc_oneshot.h" /* Одно измерение по вызову. Старого driver/adc.h в ESP-IDF 6 уже нет. */
#include "esp_adc/adc_cali.h" /* Перевод сырого кода АЦП в милливольты. */
#include "esp_adc/adc_cali_scheme.h" /* Заводская кривая, по которой код становится напряжением. */
#include "esp_log.h" /* Печать сырого кода и милливольт в монитор. */

/*
 * Канал ADC1 и вывод ESP32-C3:
 *   GPIO0 → ADC1_CHANNEL_0
 *   GPIO1 → ADC1_CHANNEL_1
 *   GPIO2 → ADC1_CHANNEL_2
 *   GPIO3 → ADC1_CHANNEL_3
 *   GPIO4 → ADC1_CHANNEL_4
 * GPIO0 и GPIO2 лучше не занимать без нужды: это strapping-выводы,
 * их уровень в момент сброса выбирает режим загрузки. GPIO4 спокойнее.
 */
#define ADC_GPIO_NAME "GPIO4" /* Имя вывода в логе. Сам АЦП смотрит на номер канала, не на строку. */
#define ADC_CHANNEL ADC_CHANNEL_4 /* GPIO4 подключён к каналу 4 блока ADC1. */
#define ADC_ATTEN ADC_ATTEN_DB_12 /* Ослабление 12 дБ: шкала покрывает примерно 0…3.3 В. */
#define AVERAGE_SAMPLES 16 /* Сколько отсчётов усреднять. Один отсчёт АЦП сильно шумит. */

static const char *TAG = "adc"; /* Метка в скобках перед строками лога этого примера. */

static adc_oneshot_unit_handle_t s_adc; /* Ручка блока АЦП. Дальше чтения идут через неё. */
static adc_cali_handle_t s_cali; /* Ручка калибровки. Если её нет, остаются только сырые коды. */

static void adc_setup(void) /* Включает ADC1, канал GPIO4 и заводскую калибровку. */
{
    adc_oneshot_unit_init_cfg_t unit = { /* Какой блок АЦП взять и нужен ли сопроцессор ULP. */
        .unit_id = ADC_UNIT_1, /* ADC1 не конфликтует с Wi-Fi. ADC2 на C3 с радио делит ресурсы. */
        .ulp_mode = ADC_ULP_MODE_DISABLE, /* Сопроцессор ULP в этом примере не измеряет. */
    };
    /* Ручка блока АЦП. Дальше все чтения идут через s_adc, не через номер блока. */
    ESP_ERROR_CHECK(adc_oneshot_new_unit(&unit, &s_adc)); /* Включает ADC1 и кладёт ручку в s_adc. */

    adc_oneshot_chan_cfg_t channel = { /* Диапазон и разрядность канала. В чип это попадёт вызовом ниже. */
        .atten = ADC_ATTEN, /* Ослабление выбирает диапазон. DB_12 покрывает 0…3.3 В. */
        .bitwidth = ADC_BITWIDTH_DEFAULT, /* На C3 это 12 бит, сырое значение 0…4095. */
    };
    /* Привязать канал GPIO4 к уже созданному блоку. Пока канал не настроен, читать нечего. */
    ESP_ERROR_CHECK(adc_oneshot_config_channel(s_adc, ADC_CHANNEL, &channel)); /* Привязывает GPIO4. Без этого читать нечего. */

    /*
     * Калибровка может отсутствовать на совсем необычном чипе.
     * Тогда остаётся сырое значение, а милливольты пример не печатает.
     * На серийном ESP32-C3 схема curve fitting есть.
     */
    adc_cali_curve_fitting_config_t cal = { /* Параметры кривой. Они должны совпасть с настройкой канала. */
        .unit_id = ADC_UNIT_1, /* Та же ADC1. Кривая от другого блока дала бы чужие милливольты. */
        .chan = ADC_CHANNEL, /* Канал GPIO4: у каждого входа своя заводская кривая. */
        .atten = ADC_ATTEN, /* То же ослабление 12 дБ, иначе шкала напряжения не совпадёт. */
        .bitwidth = ADC_BITWIDTH_DEFAULT, /* Те же 12 бит, в которых приходит сырой код. */
    };
    esp_err_t err = adc_cali_create_scheme_curve_fitting(&cal, &s_cali); /* Пробует взять заводскую кривую. На обычном C3 она есть. */
    if (err != ESP_OK) { /* Кривой нет. Пример не останавливаем: сырые коды всё ещё полезны. */
        s_cali = NULL; /* Пустая ручка скажет циклу, что переводить код в милливольты нечем. */
        ESP_LOGW(TAG, "калибровка недоступна (%s). Будут только сырые отсчёты", /* Предупреждение в монитор, не аварийная остановка. */
                 esp_err_to_name(err)); /* Имя ошибки вместо числа: видно, почему кривая не создалась. */
    }
}

/* Среднее из нескольких чтений. Одиночный отсчёт АЦП заметно шумит. */
static int read_average_raw(void) /* Среднее сырое значение. Так шум одного отсчёта меньше скачет в логе. */
{
    int sum = 0; /* Сюда складываем отсчёты, потом разделим на их число. */
    for (int i = 0; i < AVERAGE_SAMPLES; i++) { /* 16 чтений подряд: одного для АЦП мало. */
        int raw = 0; /* Сюда драйвер запишет один код от 0 до 4095. */
        ESP_ERROR_CHECK(adc_oneshot_read(s_adc, ADC_CHANNEL, &raw)); /* Одно измерение GPIO4. Сбой здесь остановит пример. */
        sum += raw; /* Добавляем код к сумме. Среднее посчитаем после цикла. */
    }
    return sum / AVERAGE_SAMPLES; /* Целое среднее. Дробную часть отбрасываем, для лога хватает. */
}

void app_main(void) /* Старт: настраивает АЦП и раз в полсекунды печатает напряжение. */
{
    ESP_LOGI(TAG, "ADC1 канал %s, ослабление 12 дБ, усреднение %d", /* Какой вход слушаем и из скольких отсчётов среднее. */
             ADC_GPIO_NAME, AVERAGE_SAMPLES); /* Подставляет «GPIO4» и число 16. */
    ESP_LOGI(TAG, "подайте 0…3.3 В. Напряжение выше 3.3 В повредит вывод"); /* Вход не терпит больше питания платы. */
    adc_setup(); /* Блок, канал и калибровка готовы до первого чтения. */

    while (true) { /* Напряжение на выводе может меняться, поэтому читаем без конца. */
        int raw = read_average_raw(); /* Усреднённый код. Сам по себе он ещё не вольты. */
        if (s_cali != NULL) { /* Калибровка есть, можно показать и милливольты. */
            int mv = 0; /* Сюда драйвер положит напряжение в милливольтах. */
            ESP_ERROR_CHECK(adc_cali_raw_to_voltage(s_cali, raw, &mv)); /* Заводская кривая переводит код в милливольты. */
            ESP_LOGI(TAG, "raw %4d,  %d мВ", raw, mv); /* В мониторе и код, и напряжение, чтобы было с чем сравнить. */
        } else { /* Кривой нет, честно печатаем только сырой код. */
            ESP_LOGI(TAG, "raw %4d", raw); /* Число 0…4095 без перевода в вольты. */
        }
        vTaskDelay(pdMS_TO_TICKS(500)); /* Пауза 500 мс, чтобы монитор не забивался строками. */
    }
}
