/*
 * Пример 12. Wi-Fi станция: подключиться к роутеру и получить IP.
 *
 * Станция (STA) — это роль «клиент». Роутер в этой паре называется
 * точкой доступа (AP). ESP32-C3 умеет 802.11 b/g/n на 2.4 ГГц и не
 * умеет диапазон 5 ГГц. Роутер, раздающий только 5 ГГц, чип не увидит.
 *
 * Сетевой код ESP-IDF устроен событиями. Драйвер Wi-Fi не возвращает
 * «подключился» из функции esp_wifi_connect(). Он позже присылает
 * событие WIFI_EVENT_STA_CONNECTED, а ещё позже — IP_EVENT_STA_GOT_IP,
 * когда DHCP-сервер роутера выдал адрес. Пока адреса нет, сокетами
 * пользоваться рано.
 *
 * Обработчик события должен быть коротким. Ждать внутри него нельзя:
 * им пользуется системная задача событий. Результат здесь передаётся
 * в задачу main через группу событий FreeRTOS — набор битов, которых
 * можно ждать.
 *
 * Перед первым запуском впишите имя и пароль своей сети в WIFI_SSID
 * и WIFI_PASS ниже. Пароль WPA2 не короче 8 символов.
 */

#include <string.h> /* strncpy копирует имя сети и пароль в структуру драйвера. */

/*
 * Библиотеки:
 * freertos/FreeRTOS.h — типы планировщика.
 * freertos/event_groups.h — набор битов «подключились» / «не вышло».
 *   Обработчик события бит ставит, задача main его ждёт.
 * esp_event.h — цикл событий. Wi-Fi не возвращает результат из esp_wifi_connect,
 *   а присылает событие позже.
 * esp_log.h — журнал подключения.
 * esp_netif.h — сетевой интерфейс: через него стек TCP/IP получает адрес.
 * esp_wifi.h — сам драйвер радио: режим станции, имя сети, запуск.
 * nvs_flash.h — раздел flash, где драйвер хранит калибровку радио.
 *   Без nvs_flash_init esp_wifi_init возвращает ошибку.
 */
#include "freertos/FreeRTOS.h" /* Типы планировщика. Этот заголовок подключают раньше остальных файлов FreeRTOS. */
#include "freertos/event_groups.h" /* Группа битов: обработчик ставит «есть IP» или «не вышло», main это ждёт. */
#include "esp_event.h" /* Цикл событий. Итог esp_wifi_connect приходит сюда событием, а не возвратом. */
#include "esp_log.h" /* Журнал: печатать шаги подключения в монитор. */
#include "esp_netif.h" /* Сетевой интерфейс станции, через него стек TCP/IP принимает адрес. */
#include "esp_wifi.h" /* Драйвер радио: режим станции, имя сети, запуск и запрос подключения. */
#include "nvs_flash.h" /* Раздел flash с калибровкой радио. Без него esp_wifi_init вернёт ошибку. */

#define WIFI_SSID "your-ssid" /* Имя вашей сети. Перед прошивкой замените текст в кавычках. */
#define WIFI_PASS "your-password" /* Пароль WPA2 этой сети. Он не короче 8 символов. */

#define WIFI_CONNECTED_BIT BIT0 /* Бит 0: DHCP выдал адрес, станция в сети. */
#define WIFI_FAIL_BIT BIT1 /* Бит 1: попытки кончились, подключиться не удалось. */
#define WIFI_MAX_RETRY 5 /* Сколько раз звать подключение после обрыва, прежде чем сдаться. */

static const char *TAG = "wifi_sta"; /* Подпись строк монитора, чтобы отличать их от чужих. */

static EventGroupHandle_t s_wifi_events; /* Группа битов успеха и неудачи. Создаётся позже, в wifi_start. */
static int s_retry_count; /* Сколько обрывов подряд уже было. Пока связь жива, счётчик равен нулю. */

/*
 * arg — то, что передали при подписке, у нас NULL.
 * base — семейство события: WIFI_EVENT или IP_EVENT.
 * id — конкретное событие внутри семейства.
 * data — структура с подробностями, её вид зависит от id.
 */
static void wifi_event_handler(void *arg, esp_event_base_t base, int32_t id, void *data) /* Сюда цикл событий приносит старт радио, обрыв и выдачу IP. */
{
    (void)arg; /* Аргумент подписки не используем. Так компилятор не предупреждает о лишнем параметре. */

    if (base == WIFI_EVENT && id == WIFI_EVENT_STA_START) { /* Драйвер станции запущен: можно просить подключение. */
        /* Драйвер поднялся. Теперь можно просить подключение. */
        esp_wifi_connect(); /* Начать поиск сети WIFI_SSID. Успех или обрыв придут следующим событием. */
    } else if (base == WIFI_EVENT && id == WIFI_EVENT_STA_DISCONNECTED) { /* Роутер не пустил или уже установленная связь оборвалась. */
        if (s_retry_count < WIFI_MAX_RETRY) { /* Попытки ещё не исчерпаны. */
            s_retry_count++; /* Засчитать эту попытку, чтобы не повторять подключение бесконечно. */
            ESP_LOGW(TAG, "нет соединения, попытка %d", s_retry_count); /* Предупреждение в монитор с номером попытки. */
            esp_wifi_connect(); /* Повторить подключение к той же сети. */
        } else { /* Лимит попыток исчерпан, дальше стучаться незачем. */
            xEventGroupSetBits(s_wifi_events, WIFI_FAIL_BIT); /* Поднять бит неудачи и тем самым разбудить main. */
        }
    } else if (base == IP_EVENT && id == IP_EVENT_STA_GOT_IP) { /* DHCP роутера выдал адрес: сокетами уже можно пользоваться. */
        const ip_event_got_ip_t *event = data; /* data здесь — сведения о выданном адресе, приводим указатель к этому типу. */
        s_retry_count = 0; /* Связь есть, счётчик обрывов обнуляем к следующему разу. */
        ESP_LOGI(TAG, "адрес " IPSTR, IP2STR(&event->ip_info.ip)); /* Напечатать полученный IPv4 в монитор. */
        xEventGroupSetBits(s_wifi_events, WIFI_CONNECTED_BIT); /* Поднять бит успеха, чтобы main перестал ждать. */
    }
}

static void nvs_setup(void) /* Открыть NVS: там драйвер Wi-Fi хранит калибровку радио. */
{
    /*
     * Wi-Fi хранит калибровку радио во flash через NVS.
     * Без инициализации NVS esp_wifi_init вернёт ошибку.
     * ESP_ERR_NVS_NO_FREE_PAGES бывает после смены таблицы разделов:
     * тогда раздел стирают и открывают заново.
     */
    esp_err_t err = nvs_flash_init(); /* Открыть раздел NVS. Если он в порядке, стирать ничего не нужно. */
    if (err == ESP_ERR_NVS_NO_FREE_PAGES || err == ESP_ERR_NVS_NEW_VERSION_FOUND) { /* Раздел полон или формат устарел после смены прошивки. */
        ESP_ERROR_CHECK(nvs_flash_erase()); /* Стереть NVS. Ошибка стирания остановит программу сразу. */
        err = nvs_flash_init(); /* Открыть раздел заново уже пустым. */
    }
    ESP_ERROR_CHECK(err); /* Любая другая ошибка NVS фатальна: без хранилища Wi-Fi не запустится. */
}

static void wifi_start(void) /* Поднять станцию: стек, драйвер, подписки и старт радио. */
{
    /* Группа битов создаётся пустой. Пока ни один бит не поднят, ждать её — значит спать. */
    s_wifi_events = xEventGroupCreate(); /* Пустая группа битов. Пока их нет, ожидание на ней усыпляет задачу. */

    /* Поднять стек TCP/IP. Без него адрес от роутера некуда принять. */
    ESP_ERROR_CHECK(esp_netif_init()); /* Запустить TCP/IP, иначе выданный адрес некуда сохранить. */
    /* Задача, которая раздаёт события подписчикам. Одна на всё приложение. */
    ESP_ERROR_CHECK(esp_event_loop_create_default()); /* Задача, которая раздаёт события подписчикам. Одна на всё приложение. */
    /* Сетевой интерфейс станции: через него потом пойдёт TCP/IP. */
    esp_netif_create_default_wifi_sta(); /* Интерфейс станции и клиент DHCP: через него придёт адрес роутера. */

    /* Макрос заполняет размеры внутренних буферов драйвера значениями по умолчанию. */
    wifi_init_config_t init = WIFI_INIT_CONFIG_DEFAULT(); /* Штатные размеры буферов драйвера. В этом примере их не меняют. */
    /* Драйвер радио создан, но сеть ещё не ищется и радио ещё молчит. */
    ESP_ERROR_CHECK(esp_wifi_init(&init)); /* Создать драйвер радио. Сеть ещё не ищется, радио молчит. */

    /* Любое событие Wi-Fi (старт, обрыв) придёт в wifi_event_handler. */
    ESP_ERROR_CHECK(esp_event_handler_instance_register( /* Подписать обработчик на семейство событий Wi-Fi. */
        WIFI_EVENT, ESP_EVENT_ANY_ID, wifi_event_handler, NULL, NULL)); /* Любой id: старт, обрыв и прочие. Своего аргумента и ручки нет. */
    /* Отдельная подписка: DHCP роутера выдал адрес. */
    ESP_ERROR_CHECK(esp_event_handler_instance_register( /* Вторая подписка, уже на семейство IP. */
        IP_EVENT, IP_EVENT_STA_GOT_IP, wifi_event_handler, NULL, NULL)); /* Только момент, когда станция получила адрес. */

    wifi_config_t config = {0}; /* Ноль во всех полях, чтобы в ssid не осталось мусора. */
    /*
     * Поля ssid и password — массивы байт фиксированной длины, не строки Си.
     * strncpy копирует текст и оставляет место под завершающий ноль: минус 1.
     */
    strncpy((char *)config.sta.ssid, WIFI_SSID, sizeof(config.sta.ssid) - 1); /* Имя сети в массив ssid. Минус 1 оставляет байт под завершающий ноль. */
    strncpy((char *)config.sta.password, WIFI_PASS, sizeof(config.sta.password) - 1); /* Пароль в такой же массив. Поле — байты фиксированной длины, не строка Си. */
    /*
     * Порог аутентификации: не подключаться к открытой сети, если мы
     * рассчитываем на WPA2. Для открытой сети порог ставят WIFI_AUTH_OPEN
     * и оставляют пароль пустым.
     */
    config.sta.threshold.authmode = WIFI_AUTH_WPA2_PSK; /* Не подключаться к сети слабее WPA2. Открытую точку этот пример отвергнет. */

    /* Режим станции: чип клиент роутера, свою сеть он не раздаёт. */
    ESP_ERROR_CHECK(esp_wifi_set_mode(WIFI_MODE_STA)); /* Чип только клиент роутера. Свою сеть он здесь не раздаёт. */
    /* Привязать имя и пароль к интерфейсу станции. До start() радио ещё молчит. */
    ESP_ERROR_CHECK(esp_wifi_set_config(WIFI_IF_STA, &config)); /* Отдать имя и пароль интерфейсу станции. До start радио ещё молчит. */
    /*
     * WIFI_PS_MIN_MODEM — модемный сон: между пакетами маяка радио засыпает,
     * процессор при желании тоже может спать. Это основной способ снизить
     * потребление, не отключая Wi-Fi совсем. Подробнее в примерах сна.
     */
    ESP_ERROR_CHECK(esp_wifi_set_ps(WIFI_PS_MIN_MODEM)); /* Модемный сон: между маяками радио засыпает и меньше ест ток. */
    /* Старт радио. Подключение начнётся из обработчика WIFI_EVENT_STA_START. */
    ESP_ERROR_CHECK(esp_wifi_start()); /* Включить радио. Подключение начнёт обработчик события STA_START. */
}

void app_main(void) /* Точка входа. ESP-IDF вызывает её уже внутри задачи main. */
{
    ESP_LOGI(TAG, "подключение к сети \"%s\"", WIFI_SSID); /* В монитор: к какой сети сейчас идём. */
    nvs_setup(); /* Сначала хранилище, иначе драйвер Wi-Fi не инициализируется. */
    wifi_start(); /* Поднять радио. Итог придёт битом в группе событий, а не возвратом этой функции. */

    /*
     * Ждать, пока не появится любой из двух битов.
     * Третий аргумент pdFALSE — биты после ожидания не сбрасывать.
     * Четвёртый pdFALSE — хватит одного бита, не ждать оба сразу.
     * portMAX_DELAY — ждать сколько угодно, задача при этом спит.
     */
    EventBits_t bits = xEventGroupWaitBits( /* Уснуть, пока обработчик не поднимет бит успеха или неудачи. */
        s_wifi_events, WIFI_CONNECTED_BIT | WIFI_FAIL_BIT, /* Проснуться от любого из этих двух битов. */
        pdFALSE, pdFALSE, portMAX_DELAY); /* Биты не сбрасывать, хватит одного, ждать без таймаута. */

    if (bits & WIFI_CONNECTED_BIT) { /* Бит адреса поднят: станция в сети. */
        ESP_LOGI(TAG, "станция в сети. Дальше можно открывать сокеты"); /* Подтвердить, что IP есть и сокеты уже уместны. */
    } else { /* Вместо адреса пришёл бит неудачи. */
        ESP_LOGE(TAG, "не удалось подключиться. Проверьте SSID, пароль и диапазон 2.4 ГГц"); /* Чаще всего неверные имя, пароль или сеть только на 5 ГГц. */
    }

    while (true) { /* Дальше только периодический отчёт о роутере. Этот цикл не заканчивается. */
        wifi_ap_record_t ap = {0}; /* Обнулить снимок точки, чтобы в полях не осталось мусора со стека. */
        /* Снимок роутера, к которому чип подключён сейчас: имя, канал, уровень сигнала. */
        if (esp_wifi_sta_get_ap_info(&ap) == ESP_OK) { /* Спросить драйвер, к какому роутеру подключены сейчас. */
            ESP_LOGI(TAG, "роутер \"%s\", канал %u, RSSI %d дБм", /* Печатать имя сети, номер канала и уровень сигнала. */
                     (char *)ap.ssid, ap.primary, ap.rssi); /* ssid — байты имени, primary — канал, rssi — сила в дБм. */
        }
        vTaskDelay(pdMS_TO_TICKS(5000)); /* Спать 5 секунд и отдать процессор другим задачам. */
    }
}
