/*
 * Пример 13. SoftAP: ESP32-C3 сам становится точкой доступа.
 *
 * SoftAP — «программная» точка доступа: чип раздаёт своё имя сети,
 * сам выдаёт адреса по DHCP и получает у себя адрес 192.168.4.1.
 * Домашний роутер для этого примера не нужен. Телефон или ноутбук
 * подключаются к сети ESP32C3-DEMO, пароль esp32c3demo.
 *
 * Станцией чип в этот момент не является: в интернет через него
 * уйти нельзя. Это отдельная маленькая сеть из платы и вашего телефона.
 * Роль станции была в примере 12. Одновременно STA и AP тоже возможны
 * (режим WIFI_MODE_APSTA), здесь оставлен только AP, чтобы было видно
 * одну роль.
 */

#include <string.h> /* strncpy и strlen переносят имя сети в структуру точки доступа. */

/*
 * Библиотеки:
 * freertos/FreeRTOS.h и task.h — пауза между опросами списка клиентов.
 * esp_event.h — события «точка поднялась», «клиент пришёл», «клиент ушёл».
 * esp_log.h — журнал.
 * esp_mac.h — макросы MACSTR и MAC2STR печатают шесть байт адреса клиента.
 * esp_netif.h — интерфейс точки доступа и DHCP, который раздаёт адреса телефонам.
 * esp_wifi.h — режим AP, имя сети, канал, запуск радио.
 * nvs_flash.h — калибровка радио во flash. Без инициализации Wi-Fi не стартует.
 */
#include "freertos/FreeRTOS.h" /* Типы планировщика. Подключают раньше task.h. */
#include "freertos/task.h" /* vTaskDelay: пауза между опросами списка клиентов. */
#include "esp_event.h" /* События «точка поднялась», «клиент пришёл», «клиент ушёл». */
#include "esp_log.h" /* Журнал подключений в монитор. */
#include "esp_mac.h" /* Макросы MACSTR и MAC2STR печатают шесть байт адреса клиента. */
#include "esp_netif.h" /* Интерфейс точки доступа и DHCP, который раздаёт адреса телефонам. */
#include "esp_wifi.h" /* Режим AP, имя сети, канал и запуск радио. */
#include "nvs_flash.h" /* Калибровка радио во flash. Без инициализации Wi-Fi не стартует. */

#define AP_SSID "ESP32C3-DEMO" /* Имя сети, которое телефон увидит в списке. */
#define AP_PASS "esp32c3demo" /* Пароль этой сети. Для WPA2 нужно не меньше 8 символов. */
#define AP_CHANNEL 1 /* Канал 2.4 ГГц, на котором точка будет объявлять себя. */
#define AP_MAX_CLIENTS 4 /* Сколько телефонов пускать одновременно. */

static const char *TAG = "softap"; /* Подпись строк монитора этого примера. */

static void wifi_event_handler(void *arg, esp_event_base_t base, int32_t id, void *data) /* Реакция на старт точки и на приход или уход клиента. */
{
    (void)arg; /* Аргумент подписки не используем. Так гасим предупреждение компилятора. */
    if (base != WIFI_EVENT) { /* Чужие семейства событий этой точке не интересны. */
        return; /* Выйти сразу: обработчик должен оставаться коротким. */
    }

    if (id == WIFI_EVENT_AP_START) { /* Радио точки поднялось и уже рассылает имя сети. */
        ESP_LOGI(TAG, "точка \"%s\" поднята. Адрес платы 192.168.4.1", AP_SSID); /* Сообщить имя сети и адрес, который нужно открыть. */
    } else if (id == WIFI_EVENT_AP_STACONNECTED) { /* Кто-то прошёл проверку пароля и вошёл в сеть. */
        const wifi_event_ap_staconnected_t *event = data; /* data — MAC клиента и его номер aid в точке. */
        ESP_LOGI(TAG, "клиент " MACSTR " подключился, всего aid=%d", /* Печатать адрес клиента и его номер в точке. */
                 MAC2STR(event->mac), event->aid); /* MAC2STR раскладывает шесть байт MAC по полям формата. */
    } else if (id == WIFI_EVENT_AP_STADISCONNECTED) { /* Клиент ушёл сам или точка его отключила. */
        const wifi_event_ap_stadisconnected_t *event = data; /* data — MAC того, кто отключился. */
        ESP_LOGI(TAG, "клиент " MACSTR " отключился", MAC2STR(event->mac)); /* Показать в мониторе, чей адрес пропал. */
    }
}

static void nvs_setup(void) /* Открыть NVS, иначе драйвер Wi-Fi откажется стартовать. */
{
    esp_err_t err = nvs_flash_init(); /* Открыть раздел NVS с калибровкой радио. */
    if (err == ESP_ERR_NVS_NO_FREE_PAGES || err == ESP_ERR_NVS_NEW_VERSION_FOUND) { /* Раздел полон или формат от старой прошивки. */
        ESP_ERROR_CHECK(nvs_flash_erase()); /* Стереть раздел. Ошибка здесь останавливает запуск. */
        err = nvs_flash_init(); /* Открыть уже пустой раздел. */
    }
    ESP_ERROR_CHECK(err); /* Другая ошибка NVS фатальна: без неё точка не поднимется. */
}

static void ap_start(void) /* Собрать точку доступа и включить радио. */
{
    /* Стек TCP/IP. Точке доступа он нужен, чтобы самой выдавать адреса. */
    ESP_ERROR_CHECK(esp_netif_init()); /* Запустить TCP/IP: без него точка не сможет раздать адреса. */
    /* Задача событий. Сюда драйвер потом положит «клиент подключился». */
    ESP_ERROR_CHECK(esp_event_loop_create_default()); /* Задача событий. Сюда драйвер положит «клиент подключился». */
    /* Интерфейс точки доступа. DHCP-сервер на нём включается сам. */
    esp_netif_create_default_wifi_ap(); /* Интерфейс AP. DHCP-сервер на нём включается сам, адрес платы 192.168.4.1. */

    /* Размеры внутренних буферов драйвера — штатные, из макроса. */
    wifi_init_config_t init = WIFI_INIT_CONFIG_DEFAULT(); /* Штатные размеры буферов драйвера. */
    ESP_ERROR_CHECK(esp_wifi_init(&init)); /* Создать драйвер радио. Имя сети оно ещё не рассылает. */
    /* Подписка на все события Wi-Fi. IP-события станции здесь не нужны: мы не клиент. */
    ESP_ERROR_CHECK(esp_event_handler_instance_register( /* Подписать обработчик на все события Wi-Fi. */
        WIFI_EVENT, ESP_EVENT_ANY_ID, wifi_event_handler, NULL, NULL)); /* Любой id семейства WIFI_EVENT. IP станции не слушаем: мы не клиент. */

    wifi_config_t config = { /* Описание точки. Поля ssid и пароль заполняются ниже, массивы длинные. */
        .ap = { /* Вложенная часть именно для роли точки доступа, не станции. */
            .channel = AP_CHANNEL,             /* Канал 1…13 диапазона 2.4 ГГц. Телефон должен его видеть. */
            .max_connection = AP_MAX_CLIENTS,  /* Сколько клиентов пускать одновременно. */
            .authmode = WIFI_AUTH_WPA2_PSK,    /* Сеть с паролем. Для открытой сети пароль не задают. */
        }, /* Конец описания точки доступа внутри wifi_config_t. */
    };
    strncpy((char *)config.ap.ssid, AP_SSID, sizeof(config.ap.ssid) - 1); /* Имя сети в массив ssid. Минус 1 оставляет место под ноль. */
    strncpy((char *)config.ap.password, AP_PASS, sizeof(config.ap.password) - 1); /* Пароль в массив password тем же способом. */
    config.ap.ssid_len = strlen(AP_SSID); /* Длина имени. Драйверу она нужна отдельно: ssid — не обычная строка Си. */

    /* Только точка доступа. Режим станции в этом примере выключен. */
    ESP_ERROR_CHECK(esp_wifi_set_mode(WIFI_MODE_AP)); /* Только точка доступа. Роль станции здесь выключена. */
    ESP_ERROR_CHECK(esp_wifi_set_config(WIFI_IF_AP, &config)); /* Привязать имя, пароль и канал к интерфейсу точки. */
    /* После start радио начинает рассылать имя сети. Адрес платы будет 192.168.4.1. */
    ESP_ERROR_CHECK(esp_wifi_start()); /* Включить радио: оно начнёт рассылать имя, адрес платы будет 192.168.4.1. */
}

void app_main(void) /* Точка входа: поднять точку и время от времени печатать число клиентов. */
{
    ESP_LOGI(TAG, "SSID %s, пароль %s, канал %d", AP_SSID, AP_PASS, AP_CHANNEL); /* Показать в мониторе, к какой сети подключать телефон. */
    nvs_setup(); /* Хранилище нужно до драйвера Wi-Fi. */
    ap_start(); /* Поднять точку. Дальше клиенты приходят событиями. */

    while (true) { /* Бесконечный опрос списка клиентов. Программа здесь живёт постоянно. */
        vTaskDelay(pdMS_TO_TICKS(10000)); /* Спать 10 секунд, чтобы не опрашивать драйвер сплошным циклом. */
        wifi_sta_list_t clients = {0}; /* Обнулить список: num и адреса не должны содержать мусор. */
        /* Список тех, кто уже в сети платы. num — их количество. */
        if (esp_wifi_ap_get_sta_list(&clients) == ESP_OK) { /* Запросить у драйвера, кто сейчас подключён. */
            ESP_LOGI(TAG, "сейчас подключено клиентов: %d", clients.num); /* num — сколько записей драйвер положил в список. */
        }
    }
}
