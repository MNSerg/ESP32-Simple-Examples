/*
 * Пример 14. TCP-сервер поверх своей точки доступа.
 *
 * TCP — поток байтов с гарантией доставки: потерянный пакет стек
 * отправит ещё раз, получатель увидит байты в том же порядке.
 * Сервер ждёт входящие соединения на порту. Клиент (ноутбук) сам
 * открывает соединение на адрес сервера и этот порт.
 *
 * Чтобы пример не зависел от домашнего роутера, плата сначала
 * поднимает SoftAP из примера 13. Дальше с ноутбука, подключённого
 * к сети ESP32C3-DEMO:
 *
 *   nc 192.168.4.1 3333
 *
 * Наберите строку и нажмите Enter. Плата вернёт её с приставкой echo
 * и продублирует в монитор. Это тот же приём, что UART-эхо, только
 * байты идут по Wi-Fi.
 *
 * Сокеты в ESP-IDF — это LwIP с привычным интерфейсом BSD:
 * socket, bind, listen, accept, recv, send, close.
 */

#include <errno.h>  /* Номер ошибки сокета. LwIP кладёт его в errno, как обычный BSD-сокет. */
#include <string.h> /* strncpy, strlen. */

/*
 * Библиотеки:
 * freertos/FreeRTOS.h и task.h — отдельная задача сервера. accept в ней
 *   блокируется, пока никто не подключился, и не мешает остальной системе.
 * esp_event.h, esp_netif.h, esp_wifi.h, nvs_flash.h — поднять SoftAP,
 *   чтобы у сервера был адрес 192.168.4.1 без домашнего роутера.
 * esp_log.h — продублировать принятый текст в монитор.
 * lwip/sockets.h — сокеты LwIP в стиле BSD: socket, bind, listen, accept, recv, send.
 */
#include "freertos/FreeRTOS.h" /* Типы планировщика. Нужен до task.h. */
#include "freertos/task.h" /* xTaskCreate уносит accept в отдельную задачу, чтобы он не блокировал main. */
#include "esp_event.h" /* Цикл событий, без него драйвер Wi-Fi не стартует. */
#include "esp_log.h" /* Продублировать принятый текст в монитор. */
#include "esp_netif.h" /* Интерфейс точки доступа: у сервера будет адрес 192.168.4.1. */
#include "esp_wifi.h" /* Поднять SoftAP, чтобы пример не зависел от домашнего роутера. */
#include "nvs_flash.h" /* Калибровка радио. Без NVS esp_wifi_init вернёт ошибку. */
#include "lwip/sockets.h" /* Сокеты LwIP в стиле BSD: socket, bind, listen, accept, recv, send. */

#define AP_SSID "ESP32C3-DEMO" /* Имя сети, к которой подключают ноутбук перед nc. */
#define AP_PASS "esp32c3demo" /* Пароль этой сети, не короче 8 символов. */
#define TCP_PORT 3333 /* Порт, на котором сервер ждёт nc 192.168.4.1 3333. */

static const char *TAG = "tcp"; /* Подпись строк монитора этого примера. */

static void nvs_setup(void) /* Открыть NVS до старта Wi-Fi. */
{
    esp_err_t err = nvs_flash_init(); /* Открыть раздел, где лежит калибровка радио. */
    if (err == ESP_ERR_NVS_NO_FREE_PAGES || err == ESP_ERR_NVS_NEW_VERSION_FOUND) { /* Раздел полон или формат устарел. */
        ESP_ERROR_CHECK(nvs_flash_erase()); /* Стереть NVS и остановиться, если стирание не удалось. */
        err = nvs_flash_init(); /* Открыть раздел заново. */
    }
    ESP_ERROR_CHECK(err); /* Иная ошибка NVS не даст поднять точку и сокет. */
}

static void ap_start(void) /* Поднять свою точку доступа, чтобы у сервера был адрес. */
{
    /* Стек TCP/IP нужен раньше сокетов: без него socket() не к чему привязать. */
    ESP_ERROR_CHECK(esp_netif_init()); /* Запустить TCP/IP раньше сокетов: иначе socket не к чему привязать. */
    ESP_ERROR_CHECK(esp_event_loop_create_default()); /* Цикл событий нужен драйверу Wi-Fi, даже если мы сами на них не подписаны. */
    /* Точка доступа со своим DHCP. Адрес платы после старта — 192.168.4.1. */
    esp_netif_create_default_wifi_ap(); /* Интерфейс точки и DHCP. После старта адрес платы — 192.168.4.1. */

    wifi_init_config_t init = WIFI_INIT_CONFIG_DEFAULT(); /* Штатные буферы драйвера радио. */
    ESP_ERROR_CHECK(esp_wifi_init(&init)); /* Создать драйвер. Радио включится ниже, после режима и конфига. */

    wifi_config_t config = { /* Параметры точки. Имя и пароль копируются следующими строками. */
        .ap = { /* Блок роли AP: канал, лимит клиентов и тип защиты. */
            .channel = 1, /* Канал 1 диапазона 2.4 ГГц. Его видит обычный ноутбук. */
            .max_connection = 4, /* Не больше четырёх клиентов одновременно. */
            .authmode = WIFI_AUTH_WPA2_PSK, /* Сеть закрыта паролем WPA2. */
        },
    };
    strncpy((char *)config.ap.ssid, AP_SSID, sizeof(config.ap.ssid) - 1); /* Имя сети в массив ssid, с местом под завершающий ноль. */
    strncpy((char *)config.ap.password, AP_PASS, sizeof(config.ap.password) - 1); /* Пароль в массив password тем же ограничением длины. */
    config.ap.ssid_len = strlen(AP_SSID); /* Сообщить драйверу длину имени: поле ssid не обязано быть строкой Си. */

    ESP_ERROR_CHECK(esp_wifi_set_mode(WIFI_MODE_AP)); /* Только точка доступа, станцией плата в этом примере не является. */
    ESP_ERROR_CHECK(esp_wifi_set_config(WIFI_IF_AP, &config)); /* Привязать имя, пароль и канал к интерфейсу точки. */
    ESP_ERROR_CHECK(esp_wifi_start()); /* Включить радио. После этого к сети можно подключить ноутбук. */
}

/* Обслужить одного уже принятого клиента, пока он сам не закроет соединение. */
static void serve_client(int client) /* client — дескриптор уже принятого соединения, не слушающего сокета. */
{
    const char *hello = "ESP32-C3 TCP. Наберите строку.\r\n"; /* Приветствие, которое клиент увидит сразу после подключения. */
    send(client, hello, strlen(hello), 0); /* Отправить приветствие. Последний 0 — обычная отправка без флагов. */

    char buffer[128]; /* Буфер одной порции. TCP может прислать строку кусками, это нормально. */
    while (true) { /* Читать, пока клиент сам не закроется или не случится ошибка. */
        /*
         * recv читает уже принятые байты. Последний аргумент 0 — без флагов.
         * Минус один байт оставляем под завершающий ноль, чтобы строку можно было печатать.
         * Вызов блокирует задачу, пока клиент что-нибудь не пришлёт или не закроется.
         */
        int received = recv(client, buffer, sizeof(buffer) - 1, 0); /* Прочитать байты. Минус 1 байт оставлен под ноль в конце. */
        if (received < 0) { /* Отрицательное значение — сбой сокета, а не «данных нет». */
            ESP_LOGW(TAG, "recv: errno %d", errno); /* Показать номер ошибки, который LwIP положил в errno. */
            break; /* Выйти из цикла и закрыть этого клиента. Слушающий сокет останется. */
        }
        if (received == 0) { /* Ноль байт значит, что клиент закрыл свою сторону соединения. */
            ESP_LOGI(TAG, "клиент закрыл соединение"); /* Это штатный конец сессии, не ошибка. */
            break; /* Закончить обслуживание и перейти к close. */
        }
        buffer[received] = 0; /* Ноль в конец, чтобы ESP_LOGI напечатал текст, а не мусор. */
        ESP_LOGI(TAG, "принято: %s", buffer); /* Продублировать принятый текст в монитор. */
        /* send отдаёт байты в стек. 0 в конце — обычная отправка без флагов. */
        send(client, "echo: ", 6, 0); /* Приставка echo. Длина 6 задана числом: send не ищет завершающий ноль. */
        send(client, buffer, received, 0); /* Вернуть ровно принятые байты, без добавленного нуля. */
    }
    /* close освобождает дескриптор клиента. Слушающий сокет при этом жив. */
    close(client); /* Отпустить дескриптор клиента. Слушающий сокет при этом остаётся открытым. */
}

static void tcp_server_task(void *arg) /* Задача сервера. accept внутри может спать, не занимая процессор. */
{
    (void)arg; /* xTaskCreate передала NULL. Явно отмечаем, что аргумент задачи не нужен. */

    /*
     * AF_INET — адреса IPv4. SOCK_STREAM — поток байтов, то есть TCP, не UDP.
     * Возврат — целое число, дескриптор. Отрицательное значение означает ошибку.
     */
    int listen_fd = socket(AF_INET, SOCK_STREAM, IPPROTO_IP); /* Создать TCP-сокет IPv4. Отрицательный результат — ошибка. */
    if (listen_fd < 0) { /* Сокет не создан, слушать порт нечем. */
        ESP_LOGE(TAG, "socket() не создал дескриптор, errno %d", errno); /* Записать errno: по нему видно, почему сокет не выделился. */
        vTaskDelete(NULL); /* Удалить текущую задачу. NULL — это «удали меня». */
        return; /* Сюда выполнение не доходит: vTaskDelete уже удалила эту задачу. */
    }

    /*
     * SO_REUSEADDR позволяет заново занять порт сразу после закрытия сервера.
     * Иначе система несколько десятков секунд держит порт «занятым».
     */
    int reuse = 1; /* 1 включает параметр сокета, 0 оставил бы поведение по умолчанию. */
    setsockopt(listen_fd, SOL_SOCKET, SO_REUSEADDR, &reuse, sizeof(reuse)); /* Разрешить занять порт 3333 сразу, не ждать тайм-аут после закрытия. */

    struct sockaddr_in address = { /* Адрес, на котором сервер будет ждать соединения. */
        .sin_family = AF_INET, /* Семейство IPv4, то же, что у socket выше. */
        /*
         * htons переставляет байты порта в сетевой порядок.
         * На бумаге порт 3333, в пакете байты лежат иначе, чем в памяти ESP32-C3.
         */
        .sin_port = htons(TCP_PORT), /* Порт в сетевом порядке байт. На бумаге это 3333. */
        /* INADDR_ANY — слушать на всех своих адресах, в том числе на 192.168.4.1. */
        .sin_addr.s_addr = htonl(INADDR_ANY), /* Слушать на всех своих адресах, включая 192.168.4.1. */
    };
    if (bind(listen_fd, (struct sockaddr *)&address, sizeof(address)) != 0) { /* Привязать сокет к порту. Не ноль — порт занят или адрес неверен. */
        ESP_LOGE(TAG, "bind порта %d не удался, errno %d", TCP_PORT, errno); /* Показать порт и errno, чтобы было видно причину. */
        close(listen_fd); /* Закрыть так и не привязанный сокет, чтобы не течь дескриптором. */
        vTaskDelete(NULL); /* Завершить задачу сервера: без bind слушать нечего. */
        return; /* Сюда выполнение не доходит: vTaskDelete уже удалила эту задачу. */
    }
    /* Один клиент в очереди ожидания. Сразу больше одного пример не обслуживает. */
    if (listen(listen_fd, 1) != 0) { /* Начать слушать. 1 — длина очереди тех, кто ждёт accept. */
        ESP_LOGE(TAG, "listen не удался, errno %d", errno); /* listen почти не падает, но ошибку всё равно показываем. */
        close(listen_fd); /* Освободить сокет, раз очередь ожидания не открылась. */
        vTaskDelete(NULL); /* Остановить задачу: принимать соединения она не сможет. */
        return; /* Сюда выполнение не доходит: vTaskDelete уже удалила эту задачу. */
    }

    ESP_LOGI(TAG, "слушаю %d. С ноутбука в сети %s:  nc 192.168.4.1 %d", /* Подсказать команду nc: адрес, порт и имя сети. */
             TCP_PORT, AP_SSID, TCP_PORT); /* Порт печатается дважды: в тексте «слушаю» и в самой команде. */

    while (true) { /* Принимать клиентов по одному, бесконечно. */
        struct sockaddr_in peer = {0}; /* Сюда accept запишет адрес того, кто подключился. */
        socklen_t peer_len = sizeof(peer); /* Вход: размер буфера адреса. Выход: сколько байт accept записал. */
        /*
         * accept блокирует задачу, пока никто не подключился.
         * Остальные задачи FreeRTOS в это время работают.
         */
        int client = accept(listen_fd, (struct sockaddr *)&peer, &peer_len); /* Спать, пока кто-нибудь не подключится. Вернётся дескриптор клиента. */
        if (client < 0) { /* accept не удался. Слушающий сокет при этом ещё жив. */
            ESP_LOGW(TAG, "accept: errno %d", errno); /* Записать причину и не ронять всю задачу. */
            continue; /* Вернуться к accept и ждать следующего клиента. */
        }
        ESP_LOGI(TAG, "соединение с %s", inet_ntoa(peer.sin_addr)); /* Показать IPv4 клиента. inet_ntoa переводит адрес в текст. */
        serve_client(client); /* Читать и возвращать строки, пока этот клиент не уйдёт. Следующий accept будет после этого. */
    }
}

void app_main(void) /* Точка входа: сеть, затем отдельная задача сервера. */
{
    nvs_setup(); /* NVS до Wi-Fi. */
    ap_start(); /* Своя точка доступа с адресом 192.168.4.1. */
    /*
     * Стек 4096 байт: внутри задачи LwIP и форматирование лога.
     * Приоритет чуть выше main, чтобы приём байтов не ждал печати статуса.
     */
    xTaskCreate(tcp_server_task, "tcp", 4096, NULL, 5, NULL); /* Задача «tcp»: стек 4096 байт, приоритет 5, аргумента и ручки нет. */
}
